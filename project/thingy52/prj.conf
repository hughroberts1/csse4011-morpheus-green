## CMakeLists.txt
```
set(BOARD thingy52_nrf52832)
set(BOARD_FLASH_RUNNER jlink)
set(CONF_FILE prj.conf segger_rtt.conf bt.conf)

cmake_minimum_required(VERSION 3.20.0)
find_package(Zephyr REQUIRED HINTS $ENV{ZEPHYR_BASE})
project(project)

#Add Include Directories
include_directories(
			../../oslib/scu_drivers/scu_ble/
            		../../oslib/scu_drivers/scu_power_management/
            		../../oslib/scu_drivers/scu_sensors/
	    		../../oslib/scu_drivers/scu_io/
			)


#Add Target Sources
target_sources(app PRIVATE 
			src/main.c
			../../oslib/scu_drivers/scu_ble/scu_hci.c
			../../oslib/scu_drivers/scu_ble/scu_ble.c
            		../../oslib/scu_drivers/scu_power_management/scu_power_management.c
            		../../oslib/scu_drivers/scu_sensors/scu_sensors.c
	    		../../oslib/scu_drivers/scu_io/scu_io.c
			)
```

## prj.conf
```kconfig
CONFIG_STDOUT_CONSOLE=y
CONFIG_I2C=y
CONFIG_SENSOR=y
CONFIG_CBPRINTF_FP_SUPPORT=y
CONFIG_HTS221=y
CONFIG_HTS221_TRIGGER_NONE=y
CONFIG_LPS22HB=y
CONFIG_LIS2DH=y
CONFIG_LIS2DH_TRIGGER_NONE=y
CONFIG_CCS811=y
CONFIG_CCS811_TRIGGER_NONE=n
CONFIG_GPIO=y
CONFIG_PWM=y
CONFIG_PWM_LOG_LEVEL_DBG=y
CONFIG_THINGY_52=y
CONFIG_PM_DEVICE_RUNTIME=y
```

## src/main.c
```c
#include <zephyr.h>
#include <device.h>
#include <devicetree.h>
#include <drivers/gpio.h>
#include <sys/printk.h>

/* Include files from our library */
#include "scu_sensors.h"




void main (void)
{       
        while(1) {
	        scu_sensors_temp_get();
                scu_sensors_hum_get();
	        scu_sensors_voc_get();
                scu_sensors_pressure_get();
                k_sleep(K_SECONDS(1));
        }
}
```
