## CMakeLists.txt
```
set(BOARD particle_argon)
set(BOARD_FLASH_RUNNER jlink)
set(CONF_FILE prj.conf segger_rtt.conf bt.conf)

cmake_minimum_required(VERSION 3.20.0)
find_package(Zephyr REQUIRED HINTS $ENV{ZEPHYR_BASE})
project(test)

#Add Include Directories
include_directories(
			./			
			)

#Add Target Sources
target_sources(app PRIVATE 
			src/main.c
            		./sen5x_i2c.c
            		./sensirion_common.c
            		./sensirion_i2c.c
            		./sensirion_i2c_hal.c
			)
```

## prj.conf
```kconfig
CONFIG_STDOUT_CONSOLE=y
CONFIG_I2C=y
CONFIG_SENSOR=y
CONFIG_CBPRINTF_FP_SUPPORT=y
CONFIG_GPIO=y
CONFIG_PWM=n
CONFIG_PWM_LOG_LEVEL_DBG=n
CONFIG_PM_DEVICE_RUNTIME=n
CONFIG_SEN54=y
```

## bt.conf
```kconfig
#BT On
CONFIG_BT=y
#Become an observer 
CONFIG_BT_OBSERVER=y
#BT Log Level Debug
CONFIG_BT_DEBUG_LOG=y

CONFIG_BT_DEVICE_NAME="Splinter"
#Enable support for the Security Manager Protocol (SMP), making it possible to pair devices over LE.
CONFIG_BT_SMP=y
#Enable data signing which is used for transferring authenticated data in an unencrypted connection.
CONFIG_BT_SIGNING=y
#Select this for LE Peripheral role support
CONFIG_BT_PERIPHERAL=y
#Enable GATT Device Information service
CONFIG_BT_DIS=y
#Enable local Privacy Feature support. This makes it possible to use Resolvable Private Addresses (RPAs).
CONFIG_BT_PRIVACY=y
#Bluetooth device appearance. 
CONFIG_BT_DEVICE_APPEARANCE=833
CONFIG_BT_FIXED_PASSKEY=y

# Set the BLE to transmit with +4dbm power
CONFIG_BT_CTLR_TX_PWR_PLUS_8=y

CONFIG_BT_CONN_TX_MAX=16
#CONFIG_BT_CTLR_TX_BUFFERS=16

CONFIG_I2C_LOG_LEVEL_DBG=y
CONFIG_LOG=y

CONFIG_BT_CENTRAL=y
CONFIG_BT_GATT_CLIENT=y
CONFIG_BT_ATT_PREPARE_COUNT=3
```

## src/main.c
```c
#include <zephyr.h>
#include <device.h>
#include <devicetree.h>
#include <drivers/gpio.h>
#include <sys/printk.h>

/* Include files from our library */
#include "sen5x_i2c.h"
#include "sensirion_common.h"
#include "sensirion_i2c_hal.h"

int main(void) {
    int16_t error = 0;

    sensirion_i2c_hal_init();

    //error = sen5x_device_reset();
    if (error) {
        printk("Error executing sen5x_device_reset(): %i\n", error);
    }

    unsigned char serial_number[32];
    uint8_t serial_number_size = 32;
    error = sen5x_get_serial_number(serial_number, serial_number_size);
    if (error) {
        printk("Error executing sen5x_get_serial_number(): %i\n", error);
    } else {
        printk("Serial number: %s\n", serial_number);
    }

    unsigned char product_name[32];
    uint8_t product_name_size = 32;
    error = sen5x_get_product_name(product_name, product_name_size);
    if (error) {
        printk("Error executing sen5x_get_product_name(): %i\n", error);
    } else {
        printk("Product name: %s\n", product_name);
    }

    uint8_t firmware_major;
    uint8_t firmware_minor;
    bool firmware_debug;
    uint8_t hardware_major;
    uint8_t hardware_minor;
    uint8_t protocol_major;
    uint8_t protocol_minor;
    error = sen5x_get_version(&firmware_major, &firmware_minor, &firmware_debug,
                              &hardware_major, &hardware_minor, &protocol_major,
                              &protocol_minor);

    if (error) {
        printk("Error executing sen5x_get_version(): %i\n", error);
    } else {
        printk("Firmware: %u.%u, Hardware: %u.%u\n", firmware_major,
               firmware_minor, hardware_major, hardware_minor);
    }

    // set a temperature offset - supported by SEN54 and SEN55 sensors
    //
    // By default, the temperature and humidity outputs from the sensor
    // are compensated for the modules self-heating. If the module is
    // designed into a device, the temperature compensation might need
    // to be adapted to incorporate the change in thermal coupling and
    // self-heating of other device components.
    //
    // A guide to achieve optimal performance, including references
    // to mechanical design-in examples can be found in the app note
    // “SEN5x – Temperature Compensation Instruction” at www.sensirion.com.
    // Please refer to those application notes for further information
    // on the advanced compensation settings used in
    // `sen5x_set_temperature_offset_parameters`,
    // `sen5x_set_warm_start_parameter` and
    // `sen5x_set_rht_acceleration_mode`.
    //
    // Adjust temp_offset in degrees celsius to account for additional
    // temperature offsets exceeding the SEN module's self heating.
    float temp_offset = 0.0f;
    int16_t default_slope = 0;
    uint16_t default_time_constant = 0;
    error = sen5x_set_temperature_offset_parameters(
        (int16_t)(200 * temp_offset), default_slope, default_time_constant);
    if (error) {
        printk(
            "Error executing sen5x_set_temperature_offset_parameters(): %i\n",
            error);
    } else {
        printk("Temperature Offset set to %.2f °C (SEN54/SEN55 only)\n",
               temp_offset);
    }

    // Start Measurement
    error = sen5x_start_measurement();
    if (error) {
        printk("Error executing sen5x_start_measurement(): %i\n", error);
    }

    for (int i = 0; i < 60; i++) {
        // Read Measurement
        sensirion_i2c_hal_sleep_usec(1000000);

        uint16_t mass_concentration_pm1p0;
        uint16_t mass_concentration_pm2p5;
        uint16_t mass_concentration_pm4p0;
        uint16_t mass_concentration_pm10p0;
        int16_t ambient_humidity;
        int16_t ambient_temperature;
        int16_t voc_index;
        int16_t nox_index;

        error = sen5x_read_measured_values(
            &mass_concentration_pm1p0, &mass_concentration_pm2p5,
            &mass_concentration_pm4p0, &mass_concentration_pm10p0,
            &ambient_humidity, &ambient_temperature, &voc_index, &nox_index);

        if (error) {
            printk("Error executing sen5x_read_measured_values(): %i\n", error);
        } else {
            printk("Mass concentration pm1p0: %.1f µg/m³\n",
                   mass_concentration_pm1p0 / 10.0f);
            printk("Mass concentration pm2p5: %.1f µg/m³\n",
                   mass_concentration_pm2p5 / 10.0f);
            printk("Mass concentration pm4p0: %.1f µg/m³\n",
                   mass_concentration_pm4p0 / 10.0f);
            printk("Mass concentration pm10p0: %.1f µg/m³\n",
                   mass_concentration_pm10p0 / 10.0f);
            if (ambient_humidity == 0x7fff) {
                printk("Ambient humidity: n/a\n");
            } else {
                printk("Ambient humidity: %.1f %%RH\n",
                       ambient_humidity / 100.0f);
            }
            if (ambient_temperature == 0x7fff) {
                printk("Ambient temperature: n/a\n");
            } else {
                printk("Ambient temperature: %.1f °C\n",
                       ambient_temperature / 200.0f);
            }
            if (voc_index == 0x7fff) {
                printk("Voc index: n/a\n");
            } else {
                printk("Voc index: %.1f\n", voc_index / 10.0f);
            }
            if (nox_index == 0x7fff) {
                printk("Nox index: n/a\n");
            } else {
                printk("Nox index: %.1f\n", nox_index / 10.0f);
            }
        }
    }

    error = sen5x_stop_measurement();
    if (error) {
        printk("Error executing sen5x_stop_measurement(): %i\n", error);
    }
    return 0;
}
```

## src/main (copy).c
```c
#include <zephyr.h>
#include <device.h>
#include <stdio.h>
#include <sys/util.h>
#include <sys/printk.h>
#include <drivers/i2c.h>
#include <stdint.h>

#define I2C0 DT_NODELABEL(i2c0)

int read_bytes(const struct device *dev, uint16_t addr,
				 const void *write_buf, size_t num_write,
				 void *read_buf, size_t num_read)
{
	int err;
	err = i2c_write(dev, write_buf, num_write, addr);
	if (err) {
		return err;
	}

	k_msleep(20);

	err = i2c_read(dev, read_buf, num_read, addr);
	if (err) {
		return err;
	}
}

void main(void)
{
	int err;

	const struct device *device = device_get_binding(DT_LABEL(I2C0));

	if (device == NULL) {
		printk("No device found\n");
		return;
	}
	if (!device_is_ready(device)) {
		printk("Device %s is not ready\n", device->name);
		return;
	}

	k_msleep(500);

	err = i2c_configure(device, I2C_MODE_MASTER | I2C_SPEED_SET(I2C_SPEED_STANDARD));
	printk("err %d\n", err);

	k_msleep(500);

	uint8_t buffer[30];
	memset(buffer, 0, 30);
	uint8_t data[48];
	memset(data, 0, 48);

	
	buffer[0] = (0xFF00 & 0x0021) >> 8;
	buffer[1] = 0x00FF & 0x0021;

	err = i2c_write(device, buffer, 2, 0x69);
	printk("0x%02X%02X err %d\n", buffer[0], buffer[1], err);
	
	/*
	k_msleep(1000);
	buffer[0] = (0xFF00 & 0xD304) >> 8;
	buffer[1] = 0x00FF & 0xD304;
	err = i2c_write(device, buffer, 2, 0x69);
	printk("0x%02X%02X err %d\n", buffer[0], buffer[1], err);
	
	k_msleep(1000);
	buffer[0] = (0xFF00 & 0x0021) >> 8;
	buffer[1] = 0x00FF & 0x0021;
	err = i2c_write(device, buffer, 2, 0x69);
	printk("0x%02X%02X err %d\n", buffer[0], buffer[1], err);
	*/
	k_msleep(1000);

	while(1) {
		buffer[0] = (0xFF00 & 0x0202) >> 8;
		buffer[1] = 0x00FF & 0x0202;
		printk("address: 0x%02X%02X ", buffer[0], buffer[1]);
		err = read_bytes(device, 0x69, buffer, 2, data, 3);
		printk("err %d %02X %02X %02X %02X\n", err, data[0], data[1], data[2], data[3]);


		if (data[1] == 0x01) {
			buffer[0] = (0xFF00 & 0x03C4) >> 8;
			buffer[1] = 0x00FF & 0x03C4;

			err = read_bytes(device, 0x69, buffer, 2, data, 24);
			printk("%d %d\n", err, data[0]);

			printk("PM1.0: %.1f ug/m^2\n", (float)((uint16_t)((data[0] << 8) | data[1]))/10);
			printk("PM2.5: %.1f ug/m^2\n", (float)((uint16_t)((data[3] << 8) | data[4]))/10);
			printk("PM4.0: %.1f ug/m^2\n", (float)((uint16_t)((data[6] << 8) | data[7]))/10);
			printk("PM10: %.1f ug/m^2\n", (float)((uint16_t)((data[9] << 8) | data[10]))/10);
			printk("Humidity: %.2f \%RH\n", (float)((uint16_t)((data[12] << 8) | data[13]))/100);
			printk("Temperature: %.2f C\n", (float)((uint16_t)((data[15] << 8) | data[16]))/200);
			printk("VOC Index: %.1f\n", (float)((uint16_t)((data[18] << 8) | data[19]))/10);
			printk("NOx Index: %.1f\n", (float)((uint16_t)((data[21] << 8) | data[22]))/10);
		}

		k_msleep(1000);
	}
}
```
