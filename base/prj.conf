## CMakeLists.txt
```
# SPDX-License-Identifier: Apache-2.0

set(DTC_OVERLAY_FILE dtc_shell.overlay)

set(BOARD nrf52840dongle_nrf52840)

cmake_minimum_required(VERSION 3.20.0)

find_package(Zephyr REQUIRED HINTS $ENV{ZEPHYR_BASE})
project(base)

FILE(GLOB app_sources src/*.c)
target_sources(app PRIVATE ${app_sources})
```

## prj.conf
```kconfig
CONFIG_SYSTEM_WORKQUEUE_STACK_SIZE=2048

CONFIG_BT_SETTINGS=n
CONFIG_FLASH=y
CONFIG_FLASH_MAP=y
CONFIG_NVS=y
CONFIG_SETTINGS=n
CONFIG_HWINFO=y

CONFIG_BT_OBSERVER=y
CONFIG_BT_CTLR_DUP_FILTER_LEN=0
CONFIG_BT_CTLR_LE_ENC=n
CONFIG_BT_DATA_LEN_UPDATE=n
CONFIG_BT_PHY_UPDATE=n
CONFIG_BT_CTLR_CHAN_SEL_2=n
CONFIG_BT_CTLR_MIN_USED_CHAN=n
CONFIG_BT_CTLR_PRIVACY=n

CONFIG_BT_MESH_RX_SEG_MSG_COUNT=100

CONFIG_BT_PERIPHERAL=y

CONFIG_BT=y
CONFIG_BT_TINYCRYPT_ECC=y
CONFIG_BT_L2CAP_TX_BUF_COUNT=5

CONFIG_BT_MESH=y
CONFIG_BT_MESH_MODEL_EXTENSIONS=y
CONFIG_BT_MESH_RELAY=y
CONFIG_BT_MESH_FRIEND=y
CONFIG_BT_MESH_PB_GATT=y
CONFIG_BT_MESH_PB_ADV=y
CONFIG_BT_MESH_GATT_PROXY=y

#CONFIG_BT_MESH_LOW_POWER=y
#CONFIG_BT_MESH_LPN_SCAN_LATENCY=30
#CONFIG_BT_MESH_LPN_RECV_DELAY=40
#CONFIG_BT_MESH_LPN_POLL_TIMEOUT=300

CONFIG_BT_MESH_SUBNET_COUNT=2
CONFIG_BT_MESH_APP_KEY_COUNT=2
CONFIG_BT_MESH_MODEL_GROUP_COUNT=2
CONFIG_BT_MESH_LABEL_COUNT=3

CONFIG_BT_DEBUG_LOG=n

CONFIG_BT_MESH_DEBUG=y
CONFIG_BT_MESH_DEBUG_MODEL=y

#------------------------------ENABLE USB---------------------------------------
#Add this line if building for the Arduino Sense Board
#CONFIG_BOARD_ARDUINO_NANO_33_BLE_EN_USB_CONSOLE=y
CONFIG_USB_DEVICE_STACK=y
CONFIG_USB_DEVICE_PRODUCT="USB Console Tute"

CONFIG_SERIAL=y
CONFIG_CONSOLE=y
CONFIG_UART_CONSOLE=y
CONFIG_UART_LINE_CTRL=y
#------------------------------------------------------------------------------

CONFIG_CBPRINTF_FP_SUPPORT=y

#-----------------------------SHELL_CONF--------------------------------------
CONFIG_SHELL_BACKEND_SERIAL_CHECK_DTR=y
CONFIG_SHELL_BACKEND_SERIAL_INIT_PRIORITY=51
CONFIG_SHELL=y
CONFIG_SHELL_BACKENDS=y
CONFIG_SHELL_BACKEND_SERIAL=y

CONFIG_SHELL_PROMPT_UART="base:~$"

CONFIG_SHELL_CMDS=y
CONFIG_SHELL_TAB=y
CONFIG_SHELL_TAB_AUTOCOMPLETION=y
CONFIG_SHELL_VT100_COLORS=y
CONFIG_KERNEL_SHELL=y
#-----------------------------------------------------------------------------

#-----------------------------SHELL_LOGGING-----------------------------------
CONFIG_LOG=y
CONFIG_LOG_PRINTK=y
#-----------------------------------------------------------------------------
CONFIG_USB_DEVICE_VID=0xC553
CONFIG_USB_DEVICE_PID=0x4011
CONFIG_USB_DEVICE_MANUFACTURER="Hugh R"

################# PROVISIONING #########################
CONFIG_BT_MESH_PROVISIONER=y
CONFIG_BT_MESH_PROV_DEVICE=n
CONFIG_BT_MESH_CDB=y
CONFIG_BT_MESH_CDB_NODE_COUNT=16
CONFIG_BT_MESH_CDB_SUBNET_COUNT=3
CONFIG_BT_MESH_CDB_APP_KEY_COUNT=3

CONFIG_BT_MESH_CFG_CLI=y
CONFIG_BT_MESH_HEALTH_CLI=y

CONFIG_MAIN_STACK_SIZE=1408
CONFIG_MAIN_THREAD_PRIORITY=-2

CONFIG_BT_MESH_RELAY_RETRANSMIT_COUNT=3

CONFIG_BT_RX_STACK_SIZE=8000

CONFIG_BT_MESH_CRPL=100

CONFIG_LOG_BUFFER_SIZE=4096

CONFIG_BT_MESH_TX_SEG_MSG_COUNT=100
```

## src/main.c
```c
/**
 * @file main.c
 * @author Hugh Roberts
 * @brief Application main entry point
 * @version 0.1
 * @date 2022-06-05
 * 
 * @copyright Copyright (c) 2022
 * 
 */

#include <sys/printk.h>
#include <settings/settings.h>
#include <devicetree.h>
#include <device.h>
#include <drivers/gpio.h>
#include <drivers/hwinfo.h>
#include <sys/byteorder.h>
#include <bluetooth/bluetooth.h>
#include <bluetooth/mesh.h>
#include <usb/usb_device.h>
#include <drivers/uart.h>       
#include <zephyr/types.h>
#include <stddef.h>
#include <string.h>
#include <errno.h>
#include <zephyr.h>
#include <shell/shell.h>
#include <time.h>
#include <logging/log.h>
#include <bluetooth/hci.h>
#include <bluetooth/conn.h>
#include <bluetooth/uuid.h>
#include <bluetooth/gatt.h>
#include <sys/util.h>
#include <inttypes.h>

#include "board.h"
#include "mesh.h"

#define COMMAND_LINE_STACK_SIZE 1024
#define COMMAND_LINE_PRIORITY 10

void command_line_thread(void);

K_THREAD_DEFINE(command_line, COMMAND_LINE_STACK_SIZE, command_line_thread, NULL, NULL, NULL, COMMAND_LINE_PRIORITY, 0, 0);

LOG_MODULE_REGISTER(base, LOG_LEVEL_DBG);

/**
 * @brief Waits for data to be ready from the device
 * 
 */
void command_line_thread(void) {
	/* Setup DTR */
	const struct device *console_dev = DEVICE_DT_GET(DT_CHOSEN(zephyr_console));
	uint32_t dtr = 0;

	/* Wait on DTR - 'Data Terminal Ready'
	 * Will wait here until a terminal has been attached to the device
	 * This is not necessary, however, can be useful from reading early data
	 */
	while (!dtr) {
		uart_line_ctrl_get(console_dev, UART_LINE_CTRL_DTR, &dtr);
		k_sleep(K_MSEC(100));
	}
}

void main(void)
{
	/* Enable the USB Driver */
    if (usb_enable(NULL)){
        return;
	}

	int err = -1;

	err = board_init();

	if (err) {
		printk("Board init failed (err: %d)\n", err);
		return;
	}

	err = bt_init();

	if (err) {
		printk("Bluetooth init failed (err %d)\n", err);
		return;
	}

	// continuously provision for new nodes
	provision();
}
```

## src/board.c
```c
/* board.c - Generic HW interaction hooks */

/*
 * Copyright (c) 2021 Nordic Semiconductor
 *
 * SPDX-License-Identifier: Apache-2.0
 */

#include <drivers/gpio.h>
#include "board.h"

/* Locate led0 as alias or label by that name */
#if DT_NODE_EXISTS(DT_ALIAS(led0))
#define LED0 DT_ALIAS(led0)
#elif DT_NODE_EXISTS(DT_NODELABEL(led0))
#define LED0 DT_NODELABEL(led0)
#else
#define LED0 DT_INVALID_NODE
#endif

/* Locate button0 as alias or label by sw0 or button0 */
#if DT_NODE_EXISTS(DT_ALIAS(sw0))
#define BUTTON0 DT_ALIAS(sw0)
#elif DT_NODE_EXISTS(DT_ALIAS(button0))
#define BUTTON0 DT_ALIAS(button0)
#elif DT_NODE_EXISTS(DT_NODELABEL(sw0))
#define BUTTON0 DT_NODELABEL(sw0)
#elif DT_NODE_EXISTS(DT_NODELABEL(button0))
#define BUTTON0 DT_NODELABEL(button0)
#else
#define BUTTON0 DT_INVALID_NODE
#endif

#if DT_NODE_EXISTS(LED0)
#define LED0_DEV DT_PHANDLE(LED0, gpios)
#define LED0_PIN DT_PHA(LED0, gpios, pin)
#define LED0_FLAGS DT_PHA(LED0, gpios, flags)

static const struct device *led_dev = DEVICE_DT_GET(LED0_DEV);
#endif /* LED0 */

#if DT_NODE_EXISTS(BUTTON0)
#define BUTTON0_DEV DT_PHANDLE(BUTTON0, gpios)
#define BUTTON0_PIN DT_PHA(BUTTON0, gpios, pin)
#define BUTTON0_FLAGS DT_PHA(BUTTON0, gpios, flags)

static const struct device *button_dev = DEVICE_DT_GET(BUTTON0_DEV);
static struct k_work *button_work;

static void button_cb(const struct device *port, struct gpio_callback *cb,
		      gpio_port_pins_t pins)
{
	k_work_submit(button_work);
}
#endif /* BUTTON0 */

static int led_init(void)
{
#if DT_NODE_EXISTS(LED0)
	int err;

	if (!device_is_ready(led_dev)) {
		return -ENODEV;
	}

	err = gpio_pin_configure(led_dev, LED0_PIN,
				 LED0_FLAGS | GPIO_OUTPUT_INACTIVE);
	if (err) {
		return err;
	}
#else
	printk("WARNING: LEDs not supported on this board.\n");
#endif

	return 0;
}

static int button_init(void)
{
#if DT_NODE_EXISTS(BUTTON0)
	int err;

	err = gpio_pin_configure(button_dev, BUTTON0_PIN,
				 BUTTON0_FLAGS | GPIO_INPUT);
	if (err) {
		return err;
	}

	static struct gpio_callback gpio_cb;

	err = gpio_pin_interrupt_configure(button_dev, BUTTON0_PIN,
					   GPIO_INT_EDGE_TO_ACTIVE);
	if (err) {
		return err;
	}

	gpio_init_callback(&gpio_cb, button_cb, BIT(BUTTON0_PIN));
	gpio_add_callback(button_dev, &gpio_cb);
#else
	printk("WARNING: Buttons not supported on this board.\n");
#endif

	return 0;
}

int board_init(void)
{
	int err;

	err = led_init();
	if (err) {
		return err;
	}

	return button_init();
}

void board_led_set(bool val)
{
#if DT_NODE_EXISTS(LED0)
	gpio_pin_set(led_dev, LED0_PIN, val);
#endif
}
```

## src/board.h
```c
/* board.h - Board-specific hooks */

/*
 * Copyright (c) 2017 Intel Corporation
 *
 * SPDX-License-Identifier: Apache-2.0
 */

int board_init(void);

void board_led_set(bool val);
```

## src/cmd.c
```c
/**
 * @file cmd.c
 * @author Hugh Roberts
 * @brief shell commands for base node
 * @version 0.1
 * @date 2022-06-05
 * 
 * @copyright Copyright (c) 2022
 * 
 */
#include <settings/settings.h>
#include <devicetree.h>
#include <device.h>
#include <drivers/gpio.h>
#include <drivers/hwinfo.h>
#include <sys/byteorder.h>
#include <bluetooth/bluetooth.h>
#include <bluetooth/mesh.h>
#include <usb/usb_device.h>
#include <drivers/uart.h>       
#include <zephyr/types.h>
#include <stddef.h>
#include <string.h>
#include <errno.h>
#include <zephyr.h>
#include <shell/shell.h>
#include <time.h>
#include <logging/log.h>
#include <bluetooth/hci.h>
#include <bluetooth/conn.h>
#include <bluetooth/uuid.h>
#include <bluetooth/gatt.h>
#include <sys/util.h>
#include <inttypes.h>

#include "mesh.h"

/* Shell command prototypes */
static int cmd_pressure(const struct shell *, size_t, char **);
static int cmd_humidity(const struct shell *, size_t, char **);
static int cmd_temperature(const struct shell *, size_t, char **);
static int cmd_voc(const struct shell *, size_t, char **);
static int cmd_co2(const struct shell *, size_t, char **);
static int cmd_pm10(const struct shell *, size_t, char **);
static int cmd_list_nodes(const struct shell *, size_t, char **);
static int cmd_all_on(const struct shell *, size_t, char **);
static int cmd_all_off(const struct shell *, size_t, char **);
static int cmd_set_sample_period(const struct shell *, size_t, char **);

/* Register shell commands with callbacks */
SHELL_CMD_REGISTER(pressure, NULL, "Read pressure from all nodes", cmd_pressure);
SHELL_CMD_REGISTER(humidity, NULL, "Read humidity from all nodes", cmd_humidity);
SHELL_CMD_REGISTER(temperature, NULL, "Read temperature from all nodes", cmd_temperature);
SHELL_CMD_REGISTER(voc, NULL, "Read VOC from all nodes", cmd_voc);
SHELL_CMD_REGISTER(co2, NULL, "Read CO2 from all nodes", cmd_co2);
SHELL_CMD_REGISTER(pm10, NULL, "Read PM10 from all nodes", cmd_pm10);
SHELL_CMD_REGISTER(list_nodes, NULL, "List all nodes currently connected to mesh network", cmd_list_nodes);
SHELL_CMD_REGISTER(all_on, NULL, "Continuously request all nodes data", cmd_all_on);
SHELL_CMD_REGISTER(all_off, NULL, "Turn off continuous sampling", cmd_all_off);
SHELL_CMD_REGISTER(sample_period, NULL, "Set sample period of continuous sampling (seconds)", cmd_set_sample_period);

/**
 * @brief Display a list of all nodes active in the mesh network 
 * 
 * @param shell 
 * @param argc 
 * @param argv 
 * @return int 
 */
static int cmd_list_nodes(const struct shell *shell, size_t argc, char **argv)
{
	return list_nodes();
}

/**
 * @brief Request pressure reading from all nodes in the network 
 * 
 * @param shell 
 * @param argc 
 * @param argv 
 * @return int 
 */
static int cmd_pressure(const struct shell *shell, size_t argc, char **argv) 
{
	return sensor_request(PRESSURE);
}

/**
 * @brief Request humidity reading from all nodes in the network
 * 
 * @param shell 
 * @param argc 
 * @param argv 
 * @return int 
 */
static int cmd_humidity(const struct shell *shell, size_t argc, char **argv) 
{
	return sensor_request(HUMIDITY);
}

/**
 * @brief Request temperature reading from all nodes in the network 
 * 
 * @param shell 
 * @param argc 
 * @param argv 
 * @return int 
 */
static int cmd_temperature(const struct shell *shell, size_t argc, char **argv) 
{
	return sensor_request(TEMPERATURE);
}

/**
 * @brief Request VOC (volatile organic compounds) reading from all nodes in the network 
 * 
 * @param shell 
 * @param argc 
 * @param argv 
 * @return int 
 */
static int cmd_voc(const struct shell *shell, size_t argc, char **argv) 
{
	return sensor_request(VOC);
}

/**
 * @brief Request CO2 reading from all nodes in the network 
 * 
 * @param shell 
 * @param argc 
 * @param argv 
 * @return int 
 */
static int cmd_co2(const struct shell *shell, size_t argc, char **argv) 
{
	return sensor_request(CO2);
}

/**
 * @brief Reqeust PM10 (particulate matter) from all nodes in the network 
 * 
 * @param shell 
 * @param argc 
 * @param argv 
 * @return int 
 */
static int cmd_pm10(const struct shell *shell, size_t argc, char **argv) 
{
	return sensor_request(PM10);
}

/**
 * @brief Start continuously sampling all known devices from all nodes in the network 
 * 
 * @param shell 
 * @param argc 
 * @param argv 
 * @return int 
 */
static int cmd_all_on(const struct shell *shell, size_t argc, char **argv) 
{
	return sensor_continuous_on(); 
}

/**
 * @brief Stop continuous sampling 
 * 
 * @param shell 
 * @param argc 
 * @param argv 
 * @return int 
 */
static int cmd_all_off(const struct shell *shell, size_t argc, char **argv)
{
	return sensor_continuous_off();
}

/**
 * @brief Set the sampling period for continuous sampling 
 * 
 * @param shell 
 * @param argc 
 * @param argv 
 * @return int 
 */
static int cmd_set_sample_period(const struct shell *shell, size_t argc, char **argv) 
{
	return set_sample_period(argc, argv);
}
```

## src/mesh.c
```c
/**
 * @file mesh.c
 * @author Hugh Roberts
 * @brief Mesh functionality for the base node
 * @version 0.1
 * @date 2022-06-05
 * 
 * @copyright Copyright (c) 2022
 * 
 */
#include <sys/printk.h>
#include <settings/settings.h>
#include <devicetree.h>
#include <device.h>
#include <drivers/gpio.h>
#include <drivers/hwinfo.h>
#include <sys/byteorder.h>
#include <bluetooth/bluetooth.h>
#include <bluetooth/mesh.h>
#include <usb/usb_device.h>
#include <drivers/uart.h>       
#include <zephyr/types.h>
#include <stddef.h>
#include <string.h>
#include <errno.h>
#include <zephyr.h>
#include <shell/shell.h>
#include <time.h>
#include <logging/log.h>
#include <bluetooth/hci.h>
#include <bluetooth/conn.h>
#include <bluetooth/uuid.h>
#include <bluetooth/gatt.h>
#include <sys/util.h>
#include <inttypes.h>
#include <kernel.h>
#include <stdlib.h>
#include <stdio.h>

#include "mesh.h"
#include "board.h"

#define TIMER_STACK_SIZE 1024
#define TIMER_PRIORITY 5

K_SEM_DEFINE(sem_unprov_beacon, 0, 1);
K_SEM_DEFINE(sem_node_added, 0, 1);
K_SEM_DEFINE(sem_list_nodes, 0, 1);

static uint32_t sampling_period = DEFAULT_SAMPLE_PERIOD;

static const uint16_t net_idx = 0;
static const uint16_t app_idx = 0;

static uint16_t self_addr = 1, node_addr;
static uint8_t node_uuid[UUID_LENGTH]; 

static node activeNodes[MAX_NODES];
static uint8_t numNodesActive = 0; 

struct k_msgq ReceivedMessageQueue; 

// Initialise message queue (received messages from mesh nodes)
K_MSGQ_DEFINE(ReceivedMessageQueue, sizeof(ReceivedMessageQueueItem), 
        RECEIVED_QUEUE_LENGTH, RECEIVED_QUEUE_ALIGNMENT);

// initialise thread for processing incoming message
K_THREAD_DEFINE(receiveIncoming, RECEIVE_THREAD_STACK_SIZE, 
	bluetoothListen, NULL, NULL, NULL, RECEIVE_THREAD_PRIORITY, 0, 0);

void thread_list_nodes(void);

uint8_t continuous_on = 0; 

K_THREAD_DEFINE(list_nodes_thread, LIST_NODES_THREAD_STACK_SIZE, thread_list_nodes, NULL, NULL, NULL, LIST_NODES_THREAD_PRIORITY, 0, 0);

/**
 * @brief Records device ID with their name (string)
 * 
 */
struct Map devices[NUM_DEVICES] = {
	{.device_id = TEMPERATURE, .device_name = "TEMPERATURE"},
	{.device_id = PRESSURE, .device_name = "PRESSURE"},
	{.device_id = HUMIDITY, .device_name = "HUMIDITY"},
	{.device_id = VOC, .device_name = "VOC"},
	{.device_id = CO2, .device_name = "CO2"},
	{.device_id = PM10, .device_name = "PM10"},
};

/**
 * @brief Thread for continuously sampling all devices from all nodes in the network
 * 
 * @param argv 
 */
void continuous_sampling(void *argv)
{
	while (1) {
		while (continuous_on == 1) {
			for (uint8_t device = 0; device < NUM_DEVICES; device++) {
				uint8_t device_id = devices[device].device_id;
				sensor_request(device_id);
				// wait 1 seconds before requesting next device
				k_msleep(1000);
			}
			k_msleep(sampling_period);
		}
		k_msleep(1);
	}
}

K_THREAD_DEFINE(cont_sampling_thread, CONTINUOUS_THREAD_STACK_SIZE, continuous_sampling, NULL, NULL, NULL, CONTINUOUS_THREAD_PRIORITY, 0, 0);

/**
 * @brief Get the string corresponding to device_id
 * 
 * @param device_id 
 * @return char* 
 */
char* get_device_name(uint8_t device_id)
{
	for (uint8_t i = 0; i < NUM_DEVICES; i++) {
		if (devices[i].device_id == device_id) {
			return devices[i].device_name;
		}
	}
	return "No device with ID";
}

static void attention_on(struct bt_mesh_model *mod)
{
	board_led_set(true);
}

static void attention_off(struct bt_mesh_model *mod)
{
	board_led_set(false);
}

static const struct bt_mesh_health_srv_cb health_cb = {
	.attn_on = attention_on,
	.attn_off = attention_off,
};

static struct bt_mesh_health_srv health_srv = {
	.cb = &health_cb,
};

BT_MESH_HEALTH_PUB_DEFINE(health_pub, 0);


static struct bt_mesh_cfg_cli cfg_cli = {
};

static void health_current_status(struct bt_mesh_health_cli *cli, uint16_t addr,
				  uint8_t test_id, uint16_t cid, uint8_t *faults,
				  size_t fault_count)
{
	size_t i;

	printk("Health Current Status from 0x%04x\n", addr);

	if (!fault_count) {
		printk("Health Test ID 0x%02x Company ID 0x%04x: no faults\n",
		       test_id, cid);
		return;
	}

	printk("Health Test ID 0x%02x Company ID 0x%04x Fault Count %zu:\n",
	       test_id, cid, fault_count);

	for (i = 0; i < fault_count; i++) {
		printk("\t0x%02x\n", faults[i]);
	}
}

static struct bt_mesh_health_cli health_cli = {
	.current_status = health_current_status,
};

/**
 * @brief Callback for when a node replies with their sensor reading. 
 * Add the message received to a queue
 * 
 * @param model 
 * @param ctx 
 * @param buf 
 * @return int 
 */
static int sensor_status(struct bt_mesh_model *model, 
				struct bt_mesh_msg_ctx *ctx, 
				struct net_buf_simple *buf)
{	
	uint16_t addr = ctx->addr;
	struct bt_mesh_cdb_node *node = bt_mesh_cdb_node_get(addr);

	net_buf_simple_pull_u8(buf);
	uint8_t board_type = net_buf_simple_pull_u8(buf);
	uint32_t time = net_buf_simple_pull_le32(buf);
	uint8_t device = net_buf_simple_pull_u8(buf);
	uint32_t data = net_buf_simple_pull_le32(buf);

	ReceivedMessageQueueItem rxMessage; 
	rxMessage.time = time;
	rxMessage.board_type = board_type;
	rxMessage.data = data;
	rxMessage.device = device;
	memcpy(rxMessage.uuid, node->uuid, sizeof(node->uuid));

	while (k_msgq_put(&ReceivedMessageQueue, &rxMessage, K_NO_WAIT) != 0) {
		k_msgq_purge(&ReceivedMessageQueue);
	}
	
	return 0;
}

uint8_t bluetoothListen(void *args)
{
	ReceivedMessageQueueItem rxMessage;

	while (1) {
		
		k_msgq_get(&ReceivedMessageQueue, &rxMessage, K_FOREVER);

		// unpack the incoming message
		uint8_t uuid[UUID_LENGTH];
		uint32_t time = rxMessage.time;
		uint32_t data = rxMessage.data;
		uint8_t device = rxMessage.device;
		memcpy(uuid, &rxMessage.uuid, sizeof(uuid));
		
		// print out message in JSON format for python listener script
		printk("{\"UUID\": \"");
		for (uint8_t i = 0; i < UUID_LENGTH; i++) {
			printk("%02x", uuid[i]);
		}
		printk("\", \"time\": \"%d\"", time);

		float reading = *((float *)(&data));
		printk(", \"reading\": {\"%d\": \"%f\"}}\n", device, reading);

		k_msleep(PRINT_SLEEP_TIME_MS);

	}
	return 0;
}

static const struct bt_mesh_model_op sensor_cli_op[] = {
	{SENSOR_STATUS, BT_MESH_LEN_MIN(1), sensor_status},
	BT_MESH_MODEL_OP_END,
};

/**
 * @brief Callback for when a ping response is received
 * 
 * @param model 
 * @param ctx 
 * @param buf 
 */
static int gen_onoff_status(struct bt_mesh_model *model,
			     struct bt_mesh_msg_ctx *ctx,
			     struct net_buf_simple *buf)
{
	uint8_t board_type = net_buf_simple_pull_u8(buf);

	activeNodes[numNodesActive].board_type = board_type;
	activeNodes[numNodesActive].cdb_node = bt_mesh_cdb_node_get(ctx->addr);

	numNodesActive++;

	return 0;
}

static const struct bt_mesh_model_op gen_onoff_cli_op[] = {
	{OP_ONOFF_STATUS, 1, gen_onoff_status},
	BT_MESH_MODEL_OP_END,
};

/**
 * @brief Node models
 * 
 */
static struct bt_mesh_model models[] = {
	BT_MESH_MODEL_CFG_SRV,
	BT_MESH_MODEL_CFG_CLI(&cfg_cli),
	BT_MESH_MODEL_HEALTH_CLI(&health_cli),
	BT_MESH_MODEL_HEALTH_SRV(&health_srv, &health_pub),

	BT_MESH_MODEL(BT_MESH_MODEL_ID_SENSOR_CLI, sensor_cli_op, NULL, NULL),

	BT_MESH_MODEL(BT_MESH_MODEL_ID_GEN_ONOFF_CLI, gen_onoff_cli_op, NULL,
		      NULL),
};

/**
 * @brief Node elements
 * 
 */
static struct bt_mesh_elem elements[] = {
	BT_MESH_ELEM(0, models, BT_MESH_MODEL_NONE),
};

/**
 * @brief Node composition
 * 
 */
static const struct bt_mesh_comp comp = {
	.cid = BT_COMP_ID_LF,
	.elem = elements,
	.elem_count = ARRAY_SIZE(elements),
};

/**
 * @brief Send a request to all nodes in the network for the device reading 
 * 
 * @param device device (sensor) to sample
 * @return int error code
 */
int sensor_request(uint8_t device)
{
	struct bt_mesh_msg_ctx ctx = {
		.app_idx = models[SENSOR_CLIENT_MODEL].keys[0], 
		.addr = BT_MESH_ADDR_ALL_NODES,
		.send_ttl = BT_MESH_TTL_DEFAULT,
	};

	if (ctx.app_idx == BT_MESH_KEY_UNUSED) {
		printk("The Generic OnOff Client must be bound to a key before "
		       "sending.\n");

		return -ENOENT;
	}
	uint32_t currentTime = k_uptime_get_32();

	BT_MESH_MODEL_BUF_DEFINE(buf, SENSOR_GET, 1 + 4 + 1);
	bt_mesh_model_msg_init(&buf, SENSOR_GET);

	net_buf_simple_add_u8(&buf, REQUEST);
	net_buf_simple_add_le32(&buf, currentTime);
	net_buf_simple_add_u8(&buf, device);

	return bt_mesh_model_send(&models[SENSOR_CLIENT_MODEL], &ctx, &buf, NULL, NULL);
}

/**
 * @brief Start continunous sampling
 * 
 * @return int 
 */
int sensor_continuous_on(void)
{
	continuous_on = 1; 
	return 0; 
}

/**
 * @brief Stop continuous sampling 
 * 
 * @return int 
 */
int sensor_continuous_off(void)
{
	continuous_on = 0; 
	return 0; 
}

/**
 * @brief Configure the base node
 * 
 * @param self 
 */
static void configure_self(struct bt_mesh_cdb_node *self)
{
	struct bt_mesh_cdb_app_key *key;
	uint8_t status = 0;
	int err;

	printk("Configuring self...\n");

	key = bt_mesh_cdb_app_key_get(app_idx);
	if (key == NULL) {
		printk("No app-key 0x%04x\n", app_idx);
		return;
	}

	/* Add Application Key */
	err = bt_mesh_cfg_app_key_add(self->net_idx, self->addr, self->net_idx,
				      app_idx, key->keys[0].app_key, &status);
	if (err || status) {
		printk("Failed to add app-key (err %d, status %d)\n", err,
		       status);
		return;
	}

	err = bt_mesh_cfg_mod_app_bind(self->net_idx, self->addr, self->addr,
				       app_idx, BT_MESH_MODEL_ID_HEALTH_CLI,
				       &status);
	if (err || status) {
		printk("Failed to bind app-key (err %d, status %d)\n", err,
		       status);
		return;
	}

	/* Bind the client models */

	err = bt_mesh_cfg_mod_app_bind(self->net_idx, self->addr, self->addr,
				       app_idx, BT_MESH_MODEL_ID_SENSOR_CLI,
				       &status);

	err = bt_mesh_cfg_mod_app_bind(self->net_idx, self->addr, self->addr, 
						app_idx, BT_MESH_MODEL_ID_GEN_ONOFF_CLI, 
						&status);

	if (err || status) {
		printk("Failed to bind app-key (err %d, status %d)\n", err,
		       status);
		return;
	}

	atomic_set_bit(self->flags, BT_MESH_CDB_NODE_CONFIGURED);

	if (IS_ENABLED(CONFIG_BT_SETTINGS)) {
		bt_mesh_cdb_node_store(self);
	}

	printk("Configuration complete\n");
}

/**
 * @brief Configure a Configuration data base node
 * 
 * @param node 
 */
static void configure_node(struct bt_mesh_cdb_node *node)
{
	NET_BUF_SIMPLE_DEFINE(buf, BT_MESH_RX_SDU_MAX);
	struct bt_mesh_comp_p0_elem elem;
	struct bt_mesh_cdb_app_key *key;
	struct bt_mesh_comp_p0 comp;
	uint8_t status;
	int err, elem_addr;

	printk("Configuring node 0x%04x...\n", node->addr);

	key = bt_mesh_cdb_app_key_get(app_idx);
	if (key == NULL) {
		printk("No app-key 0x%04x\n", app_idx);
		return;
	}

	/* Add Application Key */
	err = bt_mesh_cfg_app_key_add(net_idx, node->addr, net_idx, app_idx,
				      key->keys[0].app_key, &status);
	if (err || status) {
		printk("Failed to add app-key (err %d status %d)\n", err, status);
		return;
	}

	/* Get the node's composition data and bind all models to the appkey */
	err = bt_mesh_cfg_comp_data_get(net_idx, node->addr, 0, &status, &buf);
	if (err || status) {
		printk("Failed to get Composition data (err %d, status: %d)\n",
		       err, status);
		return;
	}

	err = bt_mesh_comp_p0_get(&comp, &buf);
	if (err) {
		printk("Unable to parse composition data (err: %d)\n", err);
		return;
	}

	elem_addr = node->addr;
	while (bt_mesh_comp_p0_elem_pull(&comp, &elem)) {
		printk("Element @ 0x%04x: %u + %u models\n", elem_addr,
		       elem.nsig, elem.nvnd);
		for (int i = 0; i < elem.nsig; i++) {
			uint16_t id = bt_mesh_comp_p0_elem_mod(&elem, i);

			if (id == BT_MESH_MODEL_ID_CFG_CLI ||
			    id == BT_MESH_MODEL_ID_CFG_SRV) {
				continue;
			}
			printk("Binding AppKey to model 0x%03x:%04x\n",
			       elem_addr, id);

			err = bt_mesh_cfg_mod_app_bind(net_idx, node->addr,
						       elem_addr, app_idx, id,
						       &status);
			if (err || status) {
				printk("Failed (err: %d, status: %d)\n", err,
				       status);
			}
		}

		for (int i = 0; i < elem.nvnd; i++) {
			struct bt_mesh_mod_id_vnd id =
				bt_mesh_comp_p0_elem_mod_vnd(&elem, i);

			printk("Binding AppKey to model 0x%03x:%04x:%04x\n",
			       elem_addr, id.company, id.id);

			err = bt_mesh_cfg_mod_app_bind_vnd(net_idx, node->addr,
							   elem_addr, app_idx,
							   id.id, id.company,
							   &status);
			if (err || status) {
				printk("Failed (err: %d, status: %d)\n", err,
				       status);
			}
		}

		elem_addr++;
	}

	atomic_set_bit(node->flags, BT_MESH_CDB_NODE_CONFIGURED);

	if (IS_ENABLED(CONFIG_BT_SETTINGS)) {
		bt_mesh_cdb_node_store(node);
	}

	printk("Configuration complete\n");
}

/**
 * @brief Check if a node is configured
 * 
 * @param node 
 * @param data 
 * @return uint8_t 
 */
static uint8_t check_unconfigured(struct bt_mesh_cdb_node *node, void *data)
{
	if (!atomic_test_bit(node->flags, BT_MESH_CDB_NODE_CONFIGURED)) {
		if (node->addr == self_addr) {
			configure_self(node);
		} else {
			configure_node(node);
		}
	}

	return BT_MESH_CDB_ITER_CONTINUE;
}

/**
 * @brief Thread to continuous provision all beacons to join the mesh network 
 * 
 */
void provision(void)
{
    char uuid_hex_str[32 + 1];
    int err = -1;

    while (1) {
        k_sem_reset(&sem_unprov_beacon);
        k_sem_reset(&sem_node_added);
        bt_mesh_cdb_node_foreach(check_unconfigured, NULL);

        //printk("Waiting for unprovisioned beacon...\n");
        err = k_sem_take(&sem_unprov_beacon, K_SECONDS(PROVISION_WAIT_TIME));
        if (err == -EAGAIN) {
            continue;
        }

        bin2hex(node_uuid, UUID_LENGTH, uuid_hex_str, sizeof(uuid_hex_str));

        printk("Provisioning %s\n", uuid_hex_str);
        err = bt_mesh_provision_adv(node_uuid, net_idx, 0, 0);
        if (err < 0) {
            printk("Provisioning failed (err %d)\n", err);
            continue;
        }

        printk("Waiting for node to be added...\n");
        err = k_sem_take(&sem_node_added, K_SECONDS(PROVISION_WAIT_TIME));
        if (err == -EAGAIN) {
            printk("Timeout waiting for node to be added\n");
            continue;
        }

        printk("Added node 0x%04x\n", node_addr);
    }
}

/**
 * @brief Callback for unprovisioned beacon received
 * 
 * @param uuid 
 * @param oob_info 
 * @param uri_hash 
 */
static void unprovisioned_beacon(uint8_t uuid[UUID_LENGTH],
				 bt_mesh_prov_oob_info_t oob_info,
				 uint32_t *uri_hash)
{
	memcpy(node_uuid, uuid, UUID_LENGTH);
	k_sem_give(&sem_unprov_beacon);
}

/**
 * @brief Callback for mesh node added
 * 
 * @param net_idx 
 * @param uuid 
 * @param addr 
 * @param num_elem 
 */
static void node_added(uint16_t net_idx, uint8_t uuid[UUID_LENGTH], uint16_t addr, uint8_t num_elem)
{
	node_addr = addr;
	k_sem_give(&sem_node_added);
}

/**
 * @brief Set the up Configuration Data base for provisioning
 * 
 */
static void setup_cdb(void)
{
	struct bt_mesh_cdb_app_key *key;

	key = bt_mesh_cdb_app_key_alloc(net_idx, app_idx);
	if (key == NULL) {
		printk("Failed to allocate app-key 0x%04x\n", app_idx);
		return;
	}

	bt_rand(key->keys[0].app_key, UUID_LENGTH);

	if (IS_ENABLED(CONFIG_BT_SETTINGS)) {
		bt_mesh_cdb_app_key_store(key);
	}
}

/**
 * @brief Initialise the bluetooth mesh network 
 * 
 * @return int error code
 */
static int mesh_init(void)
{
    static uint8_t dev_uuid[UUID_LENGTH];

    int err = -1; 

    if (IS_ENABLED(CONFIG_HWINFO)) {
		err = hwinfo_get_device_id(dev_uuid, sizeof(dev_uuid));
	}

	if (err < 0) {
		dev_uuid[0] = 0xdd;
		dev_uuid[1] = 0xdd;
	}

    static const struct bt_mesh_prov prov = {
		.uuid = dev_uuid,
		.unprovisioned_beacon = unprovisioned_beacon,
		.node_added = node_added,
    };
    err = bt_mesh_init(&prov, &comp);
    return err;
}

/**
 * @brief Callback function for bluetooth subsystem ready 
 * 
 * @param err error code
 */
static void bt_ready(int err)
{
	uint8_t net_key[16], dev_key[16];

	err = mesh_init();

	if (err) {
		printk("Initializing mesh failed (err %d)\n", err);
		return;
	}

	printk("Mesh initialized\n");

	if (IS_ENABLED(CONFIG_BT_SETTINGS)) {
		printk("Loading stored settings\n");
		settings_load();
	}

	bt_rand(net_key, 16);

	err = bt_mesh_cdb_create(net_key);
	if (err == -EALREADY) {
		printk("Using stored CDB\n");
	} else if (err) {
		printk("Failed to create CDB (err %d)\n", err);
		return;
	} else {
		printk("Created CDB\n");
		setup_cdb();
	}

	bt_rand(dev_key, 16);

	err = bt_mesh_provision(net_key, BT_MESH_NET_PRIMARY, 0, 0, self_addr,
				dev_key);
	if (err == -EALREADY) {
		printk("Using stored settings\n");
	} else if (err) {
		printk("Provisioning failed (err %d)\n", err);
		return;
	} else {
		printk("Provisioning completed\n");
	}
}

/**
 * @brief Send a ping to all nodes in the network 
 * 
 * @return int 
 */
static int gen_onoff_send(void)
{
	struct bt_mesh_msg_ctx ctx = {
		.app_idx = models[GEN_ONOFF_CLIENT_MODEL].keys[0], /* Use the bound key */
		.addr = BT_MESH_ADDR_ALL_NODES,
		.send_ttl = BT_MESH_TTL_DEFAULT,
	};

	if (ctx.app_idx == BT_MESH_KEY_UNUSED) {
		printk("The Generic OnOff Client must be bound to a key before "
		       "sending.\n");
		return -ENOENT;
	}

	BT_MESH_MODEL_BUF_DEFINE(buf, OP_ONOFF_GET, 1);
	bt_mesh_model_msg_init(&buf, OP_ONOFF_GET);

	net_buf_simple_add_u8(&buf, 0xFF);

	printk("Sending a ping. Waiting for %d seconds for replies\n", LIST_WAIT_TIME);

	return bt_mesh_model_send(&models[GEN_ONOFF_CLIENT_MODEL], &ctx, &buf, NULL, NULL);
}

/**
 * @brief List all active nodes in the mesh network 
 * 
 * @return int 
 */
int list_nodes(void)
{
	gen_onoff_send();
	numNodesActive = 0; 
	k_sem_give(&sem_list_nodes);
	return 0;
}

/**
 * @brief Thread to wait for all nodes to reply to ping message
 * 
 */
void thread_list_nodes(void)
{
	while (1) {

		k_sem_take(&sem_list_nodes, K_FOREVER);
		// now need to wait 2 seconds and print out what was collected in that time 

		k_sleep(K_SECONDS(LIST_WAIT_TIME));

		// finished sleeping, print out what we got

		printk("Number of active nodes: %d\n", numNodesActive);
		for (uint8_t i = 0; i < numNodesActive; i++) {
			printk("Node Addr %d at: ", activeNodes[i].cdb_node->addr);
			for (uint8_t j = 0; j < UUID_LENGTH; j++) {
				printk("%02x", activeNodes[i].cdb_node->uuid[j]);
			}
			printk(" %s", activeNodes[i].board_type == THINGY ? "THINGY:52" : "PARTICLE ARGON");
			printk("\n");
			k_msleep(PRINT_SLEEP_TIME_MS);
		}	
	}
}

/**
 * @brief Set the sample period 
 * 
 * @param argc 
 * @param argv 
 * @return int 
 */
int set_sample_period(size_t argc, char** argv) 
{
	int seconds = atoi(argv[1]);
	if (seconds <= MIN_SAMPLING_PERIOD_SECONDS) {
		seconds = MIN_SAMPLING_PERIOD_SECONDS;
	} 
	if (seconds >= MAX_SAMPLING_PERIOD_SECONDS) {
		seconds = MAX_SAMPLING_PERIOD_SECONDS; 
	}
	sampling_period = 1000 * seconds; 
	return 0; 
}

/**
 * @brief Initialise bluetooth subsystem
 * 
 * @return int error code
 */
int bt_init(void)
{
	return bt_enable(bt_ready);
}
```

## src/mesh.h
```c
/**
 * @file mesh.h
 * @author Hugh Roberts
 * @brief mesh.c defines
 * @version 0.1
 * @date 2022-06-05
 * 
 * @copyright Copyright (c) 2022
 * 
 */

#define THINGY 0xF0
#define ARGON 0xF1

#define REQUEST 0xFF
#define RESPONSE 0xAF

#define TEMPERATURE 0x01
#define PRESSURE 0x02
#define HUMIDITY 0x03
#define VOC 0x04
#define CO2 0x05
#define PM10 0x06

#define NUM_DEVICES 6

#define PROVISION_WAIT_TIME 10
#define SENSOR_CLIENT_MODEL 4

#define GEN_ONOFF_CLIENT_MODEL 5

// opcodes for sensor messages
#define SENSOR_STATUS BT_MESH_MODEL_OP_2(0x00, 0x52)
#define SENSOR_GET BT_MESH_MODEL_OP_2(0x82, 0x31)

// opcodes for ping messages
#define OP_ONOFF_GET       BT_MESH_MODEL_OP_2(0x82, 0x01)
#define OP_ONOFF_STATUS    BT_MESH_MODEL_OP_2(0x82, 0x04)

#define MAX_NODES 10

#define UUID_LENGTH 16

#define RECEIVED_QUEUE_LENGTH 100
#define RECEIVED_QUEUE_ALIGNMENT 32

#define RECEIVE_THREAD_STACK_SIZE 500
#define RECEIVE_THREAD_PRIORITY 5
#define CONTINUOUS_THREAD_STACK_SIZE 1024
#define CONTINUOUS_THREAD_PRIORITY 2
#define LIST_NODES_THREAD_STACK_SIZE 500
#define LIST_NODES_THREAD_PRIORITY 5

#define LIST_WAIT_TIME 2
#define PRINT_SLEEP_TIME_MS 20

#define DEFAULT_SAMPLE_PERIOD 5000
#define MIN_SAMPLING_PERIOD_SECONDS 2
#define MAX_SAMPLING_PERIOD_SECONDS 5 * 60

typedef struct {
	uint8_t uuid[16];
	uint8_t board_type; 
	uint32_t time; 
	uint8_t device; 
	uint32_t data; 
} ReceivedMessageQueueItem;

typedef struct {
	uint8_t board_type; 
	struct bt_mesh_cdb_node* cdb_node; 
} node;

struct Map {
	uint8_t device_id; 
	char* device_name;
};

void provision(void);
int sensor_request(uint8_t device);
int sensor_continuous_on(void);
int sensor_continuous_off(void);
int set_sample_period(size_t, char**);
int list_nodes(void);
int bt_init(void);
uint8_t bluetoothListen(void *args);
```
